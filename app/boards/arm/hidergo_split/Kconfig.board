## app/boards/arm/hidergo_split/Kconfig.board
```kconfig
# nice!nano board configuration

# Copyright (c) 2020 Pete Johanson
# SPDX-License-Identifier: MIT

config BOARD_HIDERGO_SPLIT_LEFT
	bool "hidergo_split"
	depends on SOC_NRF52833_QIAA

config BOARD_HIDERGO_SPLIT_RIGHT
	bool "hidergo_split"
	depends on SOC_NRF52833_QIAA
```

## app/boards/arm/hidergo_split/Kconfig.defconfig
```kconfig
# Copyright (c) 2021 The ZMK Contributors
# SPDX-License-Identifier: MIT

if BOARD_HIDERGO_SPLIT_LEFT || BOARD_HIDERGO_SPLIT_RIGHT

config BOARD
	default "hidergo_split"

config ZMK_KEYBOARD_NAME
	default "hid:ergo split"

config USB_NRFX
	default y

# DISPLAY

config ZMK_DISPLAY
	select LVGL_USE_CONT
	select LVGL_FONT_MONTSERRAT_26
	select LVGL_FONT_MONTSERRAT_20
	select LVGL_FONT_MONTSERRAT_16
	select LVGL_USE_LABEL
	select LVGL_USE_IMG

if ZMK_DISPLAY

config SPI
	default y

config IL0323
	bool
	default y

endif # ZMK_DISPLAY

# Enable UART driver, needed for CDC ACM
config USB_CDC_ACM
	default y

config BT_CTLR
	default BT

config ZMK_BLE
	default y

config ZMK_USB
	default y

# FOR DEBUGGING
config ZMK_LOG_LEVEL
	int
	default 1

# FOR DEBUGGING
config DISPLAY_LOG_LEVEL
	int
	default 1


endif # BOARD_HIDERGO_SPLIT_LEFT || BOARD_HIDERGO_SPLIT_RIGHT
```

## app/boards/arm/hidergo_split/hidergo_split_left_defconfig
```kconfig
# SPDX-License-Identifier: MIT

CONFIG_SOC_SERIES_NRF52X=y
CONFIG_SOC_NRF52833_QIAA=y
CONFIG_BOARD_HIDERGO_SPLIT_LEFT=y

# Enable sleep
CONFIG_ZMK_SLEEP=y

# Enable MPU
CONFIG_ARM_MPU=y

# enable GPIO
CONFIG_GPIO=y

# Enable SPI
CONFIG_SPI=y
CONFIG_SPI_NRFX=y

# enable display drivers
CONFIG_ZMK_DISPLAY=y
CONFIG_SSD1306=n
CONFIG_IL0323=y
CONFIG_LVGL_HOR_RES_MAX=80
CONFIG_LVGL_VER_RES_MAX=128
CONFIG_LVGL_BITS_PER_PIXEL=1
CONFIG_LVGL_COLOR_DEPTH_1=y
CONFIG_LVGL_DPI=145
CONFIG_LVGL_VDB_SIZE=100
CONFIG_LVGL_USE_THEME_MONO=y
CONFIG_LVGL_THEME_DEFAULT_COLOR_PRIMARY_RED=n
CONFIG_LVGL_THEME_DEFAULT_COLOR_SECONDARY_RED=n
CONFIG_LVGL_THEME_DEFAULT_COLOR_PRIMARY_BLACK=y
CONFIG_LVGL_THEME_DEFAULT_COLOR_SECONDARY_WHITE=y
CONFIG_LVGL_THEME_DEFAULT_FONT_SMALL_MONTSERRAT_16=y
CONFIG_LVGL_THEME_DEFAULT_FONT_NORMAL_MONTSERRAT_26=y

#debug display
CONFIG_LVGL_LOG_LEVEL_DBG=y

CONFIG_ZMK_WIDGET_OUTPUT_STATUS=y
CONFIG_ZMK_WIDGET_BATTERY_STATUS=y
CONFIG_ZMK_WIDGET_LAYER_STATUS=y

# enable i2c
#CONFIG_I2C=y

# IQS5XX
#CONFIG_IQS5XX=y
#CONFIG_IQS5XX_THREAD_PRIORITY=100

CONFIG_USE_DT_CODE_PARTITION=y
CONFIG_BUILD_OUTPUT_UF2=y

#CONFIG_ZMK_SPLIT=y
#CONFIG_ZMK_SPLIT_BLE_ROLE_CENTRAL=n

CONFIG_MPU_ALLOW_FLASH_WRITE=y
CONFIG_NVS=y
CONFIG_SETTINGS_NVS=y
CONFIG_FLASH=y
CONFIG_FLASH_PAGE_LAYOUT=y
CONFIG_FLASH_MAP=y

# USB
CONFIG_USB_DEVICE_VID=0x1D55
CONFIG_USB_DEVICE_PID=0x6163
CONFIG_ZMK_USB=y
CONFIG_ZMK_USB_LOGGING=y
CONFIG_USB_DEVICE_MANUFACTURER="hid:ergo"
CONFIG_USB_DEVICE_PRODUCT="Split(L)"
```

## app/drivers/epd/Kconfig.il0323n
```kconfig
config IL0323N
	bool "IL0323 without ZMK display"
	depends on SPI
	depends on HEAP_MEM_POOL_SIZE != 0
	help
	  Enable IL0323 driver (without ZMK display).
```

## app/dts/bindings/epd/gooddisplay,il0323n.yaml
```yaml
description: IL0323 EPD for 80x128 display

compatible: "gooddisplay,il0323n"

include: spi-device.yaml

properties:
    height:
      type: int
      required: true
      description: Height in pixel of the panel driven by the controller

    width:
      type: int
      required: true
      description: Width in pixel of the panel driven by the controller

    reset-gpios:
      type: phandle-array
      required: true
      description: RESET pin.

        The RESET pin of GD7965 is active low.
        If connected directly the MCU pin should be configured
        as active low.

    dc-gpios:
      type: phandle-array
      required: true
      description: DC pin.

        The DC pin of GD7965 is active low (transmission command byte).
        If connected directly the MCU pin should be configured
        as active low.

    busy-gpios:
      type: phandle-array
      required: true
      description: BUSY pin.

        The BUSY pin of GD7965 is active low.
        If connected directly the MCU pin should be configured
        as active low.
```
